AUTOSAR XML (schema 4-0-3)
package /Ecuc
  module config Os: ecuc-def-edition=4.2.0, implementation-config-variant=VARIANT-PRE-COMPILE
    OsInclude: OsIncludeFileName=test_histogram_x.h
    AppMode (OsAppMode)
    OsOS: OsStackMonitoring=true, OsUseGetServiceId=true, OsUseParameterAccess=true, OsScalabilityClass=SC1, OsStatus=EXTENDED
      OsHooks: OsErrorHook=true, OsPostTaskHook=true, OsPreTaskHook=true, OsProtectionHook=true, OsShutdownHook=true, OsStartupHook=true
      OsHookStack: OsHookStackSize=512
    alt_avalon_sgdma_rx_irq (OsIsr): OsIsrInterruptNumber=12, OsIsrInterruptPriority=3, OsIsrCategory=CATEGORY_2
    alt_avalon_sgdma_tx_irq (OsIsr): OsIsrInterruptNumber=13, OsIsrInterruptPriority=3, OsIsrCategory=CATEGORY_2
    USRV_TASK (OsTask): OsTaskActivation=1U, OsTaskPriority=(TMAX_TPRI - USRV_MAIN_PRIORITY), OsTaskStackSize=USRV_STACK_SIZE, OsTaskSchedule=FULL
      OsTaskAutostart: OsTaskAppModeRef=AppMode
    LWIP_ALARM (OsAlarm): OsAlarmCounterRef=MAIN_HW_COUNTER
      OsAlarmAction
        OsAlarmCallback: OsAlarmCallbackName=LWIP_ALARM_CALLBACK
