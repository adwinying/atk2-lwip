AUTOSAR XML (schema 4-0-3)
package /Ecuc
  module config Os: ecuc-def-edition=4.2.0, implementation-config-variant=VARIANT-PRE-COMPILE
    OsInclude: OsIncludeFileName=target_test.h
    SmpC1ISR (OsIsr): OsIsrInterruptNumber=TIMER_5_IRQ, OsIsrInterruptPriority=8, OsIsrCategory=CATEGORY_1
